## build/Kconfig/Kconfig.shield.defconfig
```kconfig
osource "C:/v/nordic/MyBoards/boards/shields/*/Kconfig.defconfig"
osource "C:/ncs/v3.1.1/nrf/boards/shields/*/Kconfig.defconfig"
```

## build/ReLife_M1_V3/Kconfig/Kconfig.shield
```kconfig
osource "C:/v/nordic/MyBoards/boards/shields/*/Kconfig.shield"
osource "C:/ncs/v3.1.1/nrf/boards/shields/*/Kconfig.shield"
```

## build/ReLife_M1_V3/Kconfig/boards/Kconfig
```kconfig
# Load Zephyr board Kconfig descriptions.
osource "C:/v/nordic/MyBoards/boards/arm/boards/ReLife/relife_m1/Kconfig"
```

## build/ReLife_M1_V3/Kconfig/boards/Kconfig.defconfig
```kconfig
# Load Zephyr board defconfig descriptions.
osource "C:/v/nordic/MyBoards/boards/arm/boards/ReLife/relife_m1/Kconfig.defconfig"
```
